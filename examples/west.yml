## examples/west.yml
```yaml
manifest:
  
  defaults:
    remote: alif

  remotes:
    - name: alif
      url-base: https://github.com/alifsemi
  
  projects:
    - name: zephyr
      repo-path: zephyr_alif_2.0.git
      revision: main
      import: true
  self:
    path: .
```
